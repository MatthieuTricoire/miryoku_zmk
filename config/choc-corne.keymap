// Copyright 2023 Manna Harbour
// https://github.com/manna-harbour/miryoku

CONFIG_BT_CTLR_TX_PWR_PLUS_8=y

#include "../miryoku/custom_config.h"
#include "../miryoku/mapping/36/minidox.h"
#include "../miryoku/miryoku.dtsi"
